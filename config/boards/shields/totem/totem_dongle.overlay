/*
 * Copyright (c) 2022 The ZMK Contributors
 *
 * SPDX-License-Identifier: MIT
 */

#include "totem.dtsi"

/* 1. Safely remove the physical matrix scanner on the dongle */
/ {
    chosen {
        /delete-property/ zmk,kscan;
    };
};

&kscan0 {
    status = "disabled";
};

/* 2. Unlink the disabled scanner from the physical layout to prevent build failures */
&physical_layout0 {
    /delete-property/ kscan;
};
